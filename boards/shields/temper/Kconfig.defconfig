## boards/shields/temper/Kconfig.defconfig
```kconfig
if SHIELD_TEMPER_LEFT || SHIELD_TEMPER_RIGHT || SHIELD_TEMPER_DONGLE

config ZMK_KEYBOARD_NAME
    default "temper"

config ZMK_SPLIT
    default y

endif

# SOLO IL DONGLE DEVE ESSERE CENTRAL
if SHIELD_TEMPER_DONGLE

config ZMK_SPLIT_BLE_ROLE_CENTRAL
    default y

config ZMK_SPLIT_BLE_CENTRAL_PERIPHERALS
    default 2

endif
```

## config/west.yml
```yaml
manifest:
  remotes:
    - name: zmkfirmware
      url-base: https://github.com/zmkfirmware
    - name: urob
      url-base: https://github.com/urob
    - name: carrefinho
      url-base: https://github.com/carrefinho
  projects:
    - name: zmk
      remote: zmkfirmware
      revision: v0.3
      import: app/west.yml
    - name: zmk-auto-layer
      remote: urob
      revision: v0.3
    - name: prospector-zmk-module
      remote: carrefinho
      revision: v0.3
  self:
    path: config
```
